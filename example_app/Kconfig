## example_app/Kconfig
```kconfig
config MICROROS_EXAMPLE
  bool "micro-ROS example app"
  default n
  depends on MICROROSLIB
  ---help---
    Enable the micro-ROS example app
```

## micro_ros_lib/Kconfig
```kconfig
#
# For a description of the syntax of this configuration file,
# see the file kconfig-language.txt in the NuttX tools repository.
#

config MICROROSLIB
	tristate "micro-ROS library"
	default n
	---help---
		Enable the micro-ROS library
```
